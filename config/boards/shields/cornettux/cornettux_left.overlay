#include "cornettux.dtsi" // The shared dtsi file is included in the overlay

// Label of the kscan node in the dtsi
&kscan0 {
        compatible = "zmk,kscan-gpio-matrix";
        label = "default_kscan";
        diode-direction = "col2row";

        col-gpios = <&pro_micro 19 (GPIO_ACTIVE_HIGH)>,
                    <&pro_micro 18 (GPIO_ACTIVE_HIGH)>,
                    <&pro_micro 8 (GPIO_ACTIVE_HIGH)>,
                    <&pro_micro 7 (GPIO_ACTIVE_HIGH)>,
                    <&pro_micro 6 (GPIO_ACTIVE_HIGH)>,
                    <&pro_micro 5 (GPIO_ACTIVE_HIGH)>;
    };
