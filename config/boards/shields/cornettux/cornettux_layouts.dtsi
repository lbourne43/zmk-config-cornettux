#include <physical_layouts.dtsi>

/ {
    cornettux_physical_layout: cornettux_physical_layout {
        compatible = "zmk,physical-layout";
        display-name = "cornettux";
        transform = <&default_transform>;
        kscan = <&kscan0>;
    };
};
