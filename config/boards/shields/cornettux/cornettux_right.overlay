#include "cornettux.dtsi" // The shared dtsi file is included in the overlay
#
&default_transform { // Offset of 3 because the left side has 3 columns
    col-offset = <6>;
};

// Label of the kscan node in the dtsi
&kscan0 {
        compatible = "zmk,kscan-gpio-matrix";
        label = "kscan0";
        diode-direction = "col2row";

        col-gpios = <&pro_micro 18 (GPIO_ACTIVE_HIGH)>,
                    <&pro_micro 10 (GPIO_ACTIVE_HIGH)>,
                    <&pro_micro 8 (GPIO_ACTIVE_HIGH)>,
                    <&pro_micro 7 (GPIO_ACTIVE_HIGH)>,
                    <&pro_micro 6 (GPIO_ACTIVE_HIGH)>,
                    <&pro_micro 5 (GPIO_ACTIVE_HIGH)>;
    };

