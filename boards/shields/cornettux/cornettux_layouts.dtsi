#include <physical_layouts.dtsi>

/ {
    physical_layout0: physical_layout_0 {
        compatible = "zmk,physical-layout";
        display-name = "cornettux";
        kscan = <&kscan0>;
        transform = <&default_transform>;
    };
};
