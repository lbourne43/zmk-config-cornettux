## boards/shields/cornettux/Kconfig.defconfig
```kconfig
if SHIELD_CORNETTUX_LEFT

# Name must be less than 16 characters long!
config ZMK_KEYBOARD_NAME
    default "cornettux"

config ZMK_SPLIT_ROLE_CENTRAL
    default y

endif

if SHIELD_CORNETTUX_LEFT || SHIELD_CORNETTUX_RIGHT

config ZMK_SPLIT
    default y

endif
```

## config/boards/shields/cornettux/Kconfig.shield
```kconfig
# No whitespace after the comma or in your part name!
config SHIELD_CORNETTUX_LEFT
    def_bool $(shields_list_contains,cornettux_left)

# No whitespace after the comma or in your part name!
config SHIELD_CORNETTUX_RIGHT
    def_bool $(shields_list_contains,cornettux_right)
```
